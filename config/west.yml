## config/west.yml
```yaml
manifest:
  remotes:
    - name: zmkfirmware
      url-base: https://github.com/petejohanson
    - name: infely                             
      url-base: https://github.com/infely      
  projects:
    - name: zmk
      remote: zmkfirmware
      revision: feat/pointers-move-scroll
      import: app/west.yml
    - name: nice-view-battery                 
      remote: infely                          
      revision: main                          
  self:
    path: config
```
